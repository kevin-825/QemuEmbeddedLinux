## external/package/apps/hello/Config.in
```kconfig
config BR2_PACKAGE_HELLO
	bool "hello"
	help
	  Auto-generated package for hello.
```

## external/package/apps/my_custom_daemon/Config.in
```kconfig
config BR2_PACKAGE_MY_CUSTOM_DAEMON
	bool "my_custom_daemon"
	help
	  Auto-generated package for my_custom_daemon.
```

## external/package/drivers/custom_sensor_mod/Config.in
```kconfig
config BR2_PACKAGE_CUSTOM_SENSOR_MOD
	bool "custom_sensor_mod"
	help
	  Custom drivers package for custom_sensor_mod.
```

## external/package/drivers/example_driver/Config.in
```kconfig
config BR2_PACKAGE_EXAMPLE_DRIVER
	bool "example_driver"
	help
	  Auto-generated package for example_driver.
```

## external/package/example_apps/helllo/Config.in
```kconfig
config BR2_PACKAGE_HELLLO
	bool "helllo"
	help
	  Auto-generated package for helllo.
```

## external/package/test_apps/my_test0/Config.in
```kconfig
config BR2_PACKAGE_MY_TEST0
	bool "my_test0"
	help
	  Auto-generated package for my_test0.
```

## external/package/test_apps/temp_test/Config.in
```kconfig
config BR2_PACKAGE_TEMP_TEST
	bool "temp_test"
	help
	  Auto-generated package for temp_test.
```

## external/packages/LFD401_lab/LFD401_lab0_compiler/Config.in
```kconfig
config BR2_PACKAGE_LFD401_LAB0_COMPILER
  bool "LFD401_lab0_compiler"
  default y if BR2_EXTERNAL_PACKAGE_DEV_ALL
  help
    Auto-generated user-space application package for LFD401_lab0_compiler.
```

## external/packages/LFD401_lab/LFD401_lab1_lib/Config.in
```kconfig
config BR2_PACKAGE_LFD401_LAB1_LIB
	bool "LFD401_lab1_lib"
    default y if BR2_EXTERNAL_PACKAGE_DEV_ALL
	help
	  Auto-generated user-space application package for LFD401_lab1_lib.
```

## external/packages/LFD401_lab/lab0_primitive/Config.in
```kconfig
config BR2_PACKAGE_LAB0_PRIMITIVE
  bool "lab0_primitive"
  default y if BR2_EXTERNAL_PACKAGE_DEV_ALL
  help
    Auto-generated user-space application package for lab0_primitive.
```

## external/packages/LFD420_labs/a_LFD420_l0_primitive/Config.in
```kconfig
config BR2_PACKAGE_A_LFD420_L0_PRIMITIVE
  bool "a_LFD420_l0_primitive"
  default y if BR2_EXTERNAL_PACKAGE_DEV_ALL
  help
    Auto-generated user-space application package for a_LFD420_l0_primitive.
```

## external/packages/example_apps/a_foo/Config.in
```kconfig
config BR2_PACKAGE_A_FOO
  bool "a_foo"
  default y if BR2_EXTERNAL_PACKAGE_DEV_ALL
  help
    Auto-generated user-space application package for a_foo.
```

## external/packages/example_apps/a_hello_world/Config.in
```kconfig
config BR2_PACKAGE_A_HELLO_WORLD
  bool "a_hello_world"
  default y if BR2_EXTERNAL_PACKAGE_DEV_ALL
  help
    Auto-generated user-space application package for a_hello_world.
```

## external/packages/example_apps/bar_app/Config.in
```kconfig
config BR2_PACKAGE_BAR_APP
	bool "bar_app"
    default y if BR2_EXTERNAL_PACKAGE_DEV_ALL
	help
	  Auto-generated user-space application package for bar_app.
```

## external/packages/example_apps/foo_app/Config.in
```kconfig
config BR2_PACKAGE_FOO_APP
	bool "foo_app"
    default y if BR2_EXTERNAL_PACKAGE_DEV_ALL
	help
	  Auto-generated user-space application package for foo_app.
```

## external/packages/example_apps/hello_world/Config.in
```kconfig
config BR2_PACKAGE_HELLO_WORLD
  bool "hello_world"
  default y if BR2_EXTERNAL_PACKAGE_DEV_ALL
  help
    Auto-generated user-space application package for hello_world.
```

## external/packages/hello_app/Config.in
```kconfig
config BR2_PACKAGE_HELLO_APP
  bool "hello_app"
  default y if BR2_EXTERNAL_PACKAGE_DEV_ALL
  help
    Auto-generated user-space application package for hello_app.
```
