## external/configs/my_3_qemu_riscv64_virt_defconfig
```kconfig
BR2_riscv=y
BR2_TOOLCHAIN_EXTERNAL=y
BR2_TOOLCHAIN_EXTERNAL_CUSTOM=y
BR2_TOOLCHAIN_EXTERNAL_HAS_SSP=y
BR2_TOOLCHAIN_EXTERNAL_HAS_SSP_STRONG=y
BR2_TOOLCHAIN_EXTERNAL_CXX=y
BR2_TOOLCHAIN_EXTERNAL_FORTRAN=y
BR2_GLOBAL_PATCH_DIR="board/qemu/patches"
BR2_DOWNLOAD_FORCE_CHECK_HASHES=y
BR2_TARGET_GENERIC_HOSTNAME="QemuEmbeddedLinux"
BR2_TARGET_GENERIC_ISSUE="Welcome to K825 QemuEmbeddedLinux!"
BR2_SYSTEM_DHCP="eth0"
BR2_ROOTFS_POST_IMAGE_SCRIPT="board/qemu/post-image.sh"
BR2_ROOTFS_POST_SCRIPT_ARGS="$(BR2_DEFCONFIG)"
BR2_LINUX_KERNEL=y
BR2_LINUX_KERNEL_CUSTOM_VERSION=y
BR2_LINUX_KERNEL_CUSTOM_VERSION_VALUE="6.18.7"
BR2_LINUX_KERNEL_USE_CUSTOM_CONFIG=y
BR2_TARGET_ROOTFS_EXT2=y
BR2_TARGET_ROOTFS_EXT2_4=y
BR2_TARGET_ROOTFS_EXT2_SIZE="64M"
BR2_TARGET_OPENSBI=y
BR2_TARGET_OPENSBI_CUSTOM_VERSION=y
BR2_TARGET_OPENSBI_CUSTOM_VERSION_VALUE="1.6"
BR2_TARGET_OPENSBI_PLAT="generic"
```

## external/kernel_modules/LFD420_labs/lab0_primitive/Config.in
```kconfig
config BR2_PACKAGE_LAB0_PRIMITIVE
	bool "lab0_primitive"
	depends on BR2_LINUX_KERNEL
	default y if BR2_EXTERNAL_KMODE_DEV_ALL
	help
	  Enterprise out-of-tree kernel module and platform driver for lab0_primitive.

if BR2_PACKAGE_LAB0_PRIMITIVE

config BR2_PACKAGE_LAB0_PRIMITIVE_DEBUG
	bool "Enable Debug Mode for lab0_primitive"
	help
	  Select this to compile the module with debug flags enabled.
	  This will link debug.o and enable extra kernel logging.

endif
```

## external/kernel_modules/LFD420_labs/m_LFD420/Config.in
```kconfig
config BR2_PACKAGE_M_LFD420
	bool "m_LFD420"
	depends on BR2_LINUX_KERNEL
	default y if BR2_EXTERNAL_KMODE_DEV_ALL
	help
	  Enterprise out-of-tree kernel module and platform driver for m_LFD420.

if BR2_PACKAGE_M_LFD420

config BR2_PACKAGE_M_LFD420_DEBUG
	bool "Enable Debug Mode for m_LFD420"
	help
	  Select this to compile the module with debug flags enabled.
	  This will link debug.o and enable extra kernel logging.

endif
```

## external/kernel_modules/LFD420_labs/m_LFD420_l0_primitive/Config.in
```kconfig
config BR2_PACKAGE_M_LFD420_L0_PRIMITIVE
	bool "m_LFD420_l0_primitive"
	depends on BR2_LINUX_KERNEL
	default y if BR2_EXTERNAL_KMODE_DEV_ALL
	help
	  Enterprise out-of-tree kernel module and platform driver for m_LFD420_l0_primitive.

if BR2_PACKAGE_M_LFD420_L0_PRIMITIVE

config BR2_PACKAGE_M_LFD420_L0_PRIMITIVE_DEBUG
	bool "Enable Debug Mode for m_LFD420_l0_primitive"
	help
	  Select this to compile the module with debug flags enabled.
	  This will link debug.o and enable extra kernel logging.

endif
```

## external/kernel_modules/LFD420_labs/m_LFD420_l5_consumer/Config.in
```kconfig
config BR2_PACKAGE_M_LFD420_L5_CONSUMER
	bool "m_LFD420_l5_consumer"
	depends on BR2_LINUX_KERNEL
	default y if BR2_EXTERNAL_KMODE_DEV_ALL
	help
	  Enterprise out-of-tree kernel module and platform driver for m_LFD420_l5_consumer.

if BR2_PACKAGE_M_LFD420_L5_CONSUMER

config BR2_PACKAGE_M_LFD420_L5_CONSUMER_DEBUG
	bool "Enable Debug Mode for m_LFD420_l5_consumer"
	help
	  Select this to compile the module with debug flags enabled.
	  This will link debug.o and enable extra kernel logging.

endif
```

## external/kernel_modules/LFD420_labs/m_LFD420_l5_producer/Config.in
```kconfig
config BR2_PACKAGE_M_LFD420_L5_PRODUCER
	bool "m_LFD420_l5_producer"
	depends on BR2_LINUX_KERNEL
	default y if BR2_EXTERNAL_KMODE_DEV_ALL
	help
	  Enterprise out-of-tree kernel module and platform driver for m_LFD420_l5_producer.

if BR2_PACKAGE_M_LFD420_L5_PRODUCER

config BR2_PACKAGE_M_LFD420_L5_PRODUCER_DEBUG
	bool "Enable Debug Mode for m_LFD420_l5_producer"
	help
	  Select this to compile the module with debug flags enabled.
	  This will link debug.o and enable extra kernel logging.

endif
```

## external/kernel_modules/LFD420_labs/primitive_lab_1/Config.in
```kconfig
config BR2_PACKAGE_PRIMITIVE_LAB_1
	bool "primitive_lab_1"
	depends on BR2_LINUX_KERNEL
	default y if BR2_EXTERNAL_KMODE_DEV_ALL
	help
	  Enterprise out-of-tree kernel module and platform driver for primitive_lab_1.

if BR2_PACKAGE_PRIMITIVE_LAB_1

config BR2_PACKAGE_PRIMITIVE_LAB_1_DEBUG
	bool "Enable Debug Mode for primitive_lab_1"
	help
	  Select this to compile the module with debug flags enabled.
	  This will link debug.o and enable extra kernel logging.

endif
```

## external/kernel_modules/example_mod/foo/Config.in
```kconfig
config BR2_PACKAGE_FOO
	bool "foo"
	depends on BR2_LINUX_KERNEL
	default y if BR2_EXTERNAL_KMODE_DEV_ALL
	help
	  Enterprise out-of-tree kernel module and platform driver for foo.

if BR2_PACKAGE_FOO

config BR2_PACKAGE_FOO_DEBUG
	bool "Enable Debug Mode for foo"
	help
	  Select this to compile the module with debug flags enabled.
	  This will link debug.o and enable extra kernel logging.

endif
```

## external/kernel_modules/example_mod/helloMod/Config.in
```kconfig
config BR2_PACKAGE_HELLOMOD
	bool "helloMod"
	depends on BR2_LINUX_KERNEL
	default y if BR2_EXTERNAL_KMODE_DEV_ALL
	help
	  Enterprise out-of-tree kernel module and platform driver for helloMod.

if BR2_PACKAGE_HELLOMOD

config BR2_PACKAGE_HELLOMOD_DEBUG
	bool "Enable Debug Mode for helloMod"
	help
	  Select this to compile the module with debug flags enabled.
	  This will link debug.o and enable extra kernel logging.

endif
```

## external/kernel_modules/example_mod/m_HelloMod/Config.in
```kconfig
config BR2_PACKAGE_M_HELLOMOD
	bool "m_HelloMod"
	depends on BR2_LINUX_KERNEL
	default y if BR2_EXTERNAL_KMODE_DEV_ALL
	help
	  Enterprise out-of-tree kernel module and platform driver for m_HelloMod.

if BR2_PACKAGE_M_HELLOMOD

config BR2_PACKAGE_M_HELLOMOD_DEBUG
	bool "Enable Debug Mode for m_HelloMod"
	help
	  Select this to compile the module with debug flags enabled.
	  This will link debug.o and enable extra kernel logging.

endif
```

## external/kernel_modules/example_mod/m_foo/Config.in
```kconfig
config BR2_PACKAGE_M_FOO
	bool "m_foo"
	depends on BR2_LINUX_KERNEL
	default y if BR2_EXTERNAL_KMODE_DEV_ALL
	help
	  Enterprise out-of-tree kernel module and platform driver for m_foo.

if BR2_PACKAGE_M_FOO

config BR2_PACKAGE_M_FOO_DEBUG
	bool "Enable Debug Mode for m_foo"
	help
	  Select this to compile the module with debug flags enabled.
	  This will link debug.o and enable extra kernel logging.

endif
```

## external/linux/example-driver/Config.in
```kconfig
config BR2_LINUX_KERNEL_EXT_EXAMPLE_DRIVER
	bool "example-driver module"
	help
	  Auto-generated kernel module extension for example-driver.
```

## external/linux/example_kernel_mod/Config.in
```kconfig
config BR2_LINUX_KERNEL_EXT_EXAMPLE_KERNEL_MOD
	bool "example_kernel_mod module"
	help
	  Auto-generated kernel module extension for example_kernel_mod.
```

## external/linux/scelton/Config.in
```kconfig
config BR2_LINUX_KERNEL_EXT_SCELTON
	bool "scelton module"
	help
	  Auto-generated kernel module extension for scelton.
```

## external/lkms/example_mod/KevinsMod/Config.in
```kconfig
config BR2_EXT_KERNEL_MODULES_KEVINSMOD
	bool "KevinsMod module"
	help
	  Auto-generated kernel module extension for KevinsMod.
```

## external/lkms/example_mod/helloMod/Config.in
```kconfig
config BR2_EXT_KERNEL_MODULES_HELLOMOD
	bool "helloMod module"
	help
	  Auto-generated kernel module extension for helloMod.
```

## external/lkms/example_mod/hiMod/Config.in
```kconfig
config BR2_EXT_KERNEL_MODULES_HIMOD
	bool "hiMod module"
	help
	  Auto-generated kernel module extension for hiMod.
```

## external/lkms/example_mod/testMod/Config.in
```kconfig
config BR2_EXT_KERNEL_MODULES_TESTMOD
	bool "testMod module"
	help
	  Auto-generated kernel module extension for testMod.
```

## external/package/apps/example_app/Config.in
```kconfig
config BR2_PACKAGE_EXAMPLE_APP
	bool "example_app"
	help
	  Auto-generated package for example_app.
```
